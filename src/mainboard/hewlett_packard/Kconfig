## src/mainboard/hewlett_packard/Kconfig
```kconfig
## SPDX-License-Identifier: GPL-2.0-only

if VENDOR_HEWLETT_PACKARD

choice
	prompt "Mainboard model"

source "src/mainboard/hewlett_packard/*/Kconfig.name"

endchoice

source "src/mainboard/hewlett_packard/*/Kconfig"

config MAINBOARD_VENDOR
	string
	default "Hewlett-Packard"

endif # VENDOR_HEWLETT_PACKARD
```

## src/mainboard/hewlett_packard/hp_pavilion_dv6_notebook_pc/Kconfig
```kconfig
## SPDX-License-Identifier: GPL-2.0-only

if BOARD_HEWLETT_PACKARD_HP_PAVILION_DV6_NOTEBOOK_PC

config BOARD_SPECIFIC_OPTIONS
	def_bool y
	select BOARD_ROMSIZE_KB_8192
	select EC_ACPI
	select HAVE_ACPI_RESUME
	select HAVE_ACPI_TABLES
	select INTEL_INT15
	select MAINBOARD_HAS_LIBGFXINIT # FIXME: check this
	select NORTHBRIDGE_INTEL_SANDYBRIDGE
	select SERIRQ_CONTINUOUS_MODE
	select SOUTHBRIDGE_INTEL_C216
	select SYSTEM_TYPE_LAPTOP
	select USE_NATIVE_RAMINIT

config MAINBOARD_DIR
	string
	default "hewlett_packard/hp_pavilion_dv6_notebook_pc"

config MAINBOARD_PART_NUMBER
	string
	default "HP Pavilion dv6 Notebook PC"

config VGA_BIOS_ID
	string
	default "8086,0166"

config DRAM_RESET_GATE_GPIO # FIXME: check this
	int
	default 60

config USBDEBUG_HCD_INDEX # FIXME: check this
	int
	default 2
endif
```

## src/mainboard/hewlett_packard/hp_pavilion_dv6_notebook_pc/Kconfig.name
```kconfig
## SPDX-License-Identifier: GPL-2.0-only

config BOARD_HEWLETT_PACKARD_HP_PAVILION_DV6_NOTEBOOK_PC
	bool "HP Pavilion dv6 Notebook PC"
```
